// Generated 1-bit subset of Atkinson Hyperlegible Bold.
// Source: https://github.com/googlefonts/atkinson-hyperlegible
// SIL OFL 1.1; see third_party/atkinson-hyperlegible/OFL.txt.

constexpr std::array<std::uint8_t, 150> kSmallBitmap{{
    0x11, 0x88, 0xC6, 0x23, 0x00, 0x79, 0x31, 0x8C, 0x20, 0x82, 0x00, 0x38,
    0x70, 0xE3, 0x66, 0xCF, 0xB1, 0x80, 0x3C, 0xDB, 0x06, 0x0C, 0x0C, 0x8F,
    0x00, 0xFF, 0x0C, 0x3C, 0xC3, 0x0F, 0xC0, 0x3C, 0xCB, 0x06, 0x7C, 0x6C,
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    0x00, 0x72, 0xC6, 0x33, 0x33, 0xE0,
}};

constexpr std::array<OledGlyph, 25> kSmallGlyphs{{
    {0x0020U, 0U, 0U, 0U, 3U, 0, 0},
    {0x002FU, 0U, 5U, 7U, 4U, 0, 3},
    {0x003FU, 5U, 6U, 7U, 6U, 0, 3},
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    {0x2082U, 145U, 5U, 7U, 5U, 0, 5},
}};

constexpr std::array<std::uint8_t, 362> kMediumBitmap{{
    0x01, 0xFF, 0xF8, 0x00, 0x00, 0x00, 0x00, 0x0F, 0x80, 0xFF, 0x0F, 0x78,
    0xF9, 0xE7, 0xC7, 0x3B, 0x39, 0xDD, 0xCE, 0x6E, 0x71, 0xF3, 0xC7, 0x8F,
    0x78, 0x3F, 0xC0, 0xF8, 0x00, 0x0E, 0x07, 0x1F, 0x8F, 0xC0, 0xE0, 0x70,
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    0x1C, 0x00,
}};

constexpr std::array<OledGlyph, 18> kMediumGlyphs{{
    {0x002DU, 0U, 7U, 7U, 7U, 0, 12},
    {0x0030U, 7U, 13U, 13U, 13U, 0, 6},
    {0x0031U, 29U, 9U, 13U, 9U, 0, 6},
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    {0x0057U, 332U, 18U, 13U, 18U, 0, 6},
}};

constexpr std::array<std::uint8_t, 429> kLargeBitmap{{
    0x00, 0x1F, 0xF7, 0xFD, 0xFF, 0x00, 0x00, 0x00, 0x00, 0x00, 0x00, 0x00,
    0x03, 0xF8, 0x03, 0xFF, 0x01, 0xFF, 0xE0, 0xFC, 0xFC, 0x3E, 0x0F, 0x8F,
    0xC3, 0xE7, 0xF8, 0x79, 0xFE, 0x1E, 0x7D, 0xC7, 0x9F, 0x39, 0xE7, 0xC7,
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    0x1F, 0x00, 0x0F, 0x80, 0x07, 0xC0, 0x01, 0xC0, 0x00,
}};

constexpr std::array<OledGlyph, 12> kLargeGlyphs{{
    {0x002DU, 0U, 10U, 9U, 10U, 0, 18},
    {0x0030U, 12U, 18U, 18U, 18U, 0, 9},
    {0x0031U, 53U, 13U, 18U, 13U, 0, 9},
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    {0x003FU, 390U, 17U, 18U, 17U, 0, 9},
}};

